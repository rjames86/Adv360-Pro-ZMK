#define VERSION_MACRO
macro_ver: macro_ver {
compatible = "zmk,behavior-macro";
label = "macro_ver";
#binding-cells = <0>;
bindings = <&kp N2>, <&kp N0>, <&kp N2>, <&kp N4>, <&kp N0>, <&kp N1>, <&kp N1>, <&kp N3>, <&kp MINUS>, <&kp M>, <&kp A>, <&kp I>, <&kp N>, <&kp MINUS>, <&kp F>, <&kp N4>, <&kp N1>, <&kp F>, <&kp N5>, <&kp N3>, <&kp N6>, <&kp RET>;
};
